/*
 * Virtual cape for onewire on connector pin P8.19 (GPIO22)
 */
/dts-v1/;
/plugin/;

#include <dt-bindings/board/am335x-bbw-bbb-base.h>
#include <dt-bindings/gpio/gpio.h>
#include <dt-bindings/pinctrl/am33xx.h>

/ {
	compatible = "ti,beaglebone", "ti,beaglebone-black", "ti,beaglebone-green";

	/* identification */
	part-number = "BB-W1-P8.19";
	version = "00A0";

	/* state the resources this cape uses */
	exclusive-use =
		/* the pin header uses */
		"P8.19";

	fragment@0 {
		target = <&am33xx_pinmux>;
		__overlay__ {

			dallas_w1_pins22: pinmux_dallas_w1_pins22 {
				pinctrl-single,pins = <
					BONE_P8_19 0x37
				>;
			};
		};
	};

	fragment@1 {
		target-path="/";
		__overlay__ {

			onewire@22 {
				status = "okay";
				pinctrl-names = "default";
				pinctrl-0 = <&dallas_w1_pins22>;

				compatible = "w1-gpio";
				gpios = <&gpio0 22 GPIO_ACTIVE_HIGH>;
			};
		};
	};
};
