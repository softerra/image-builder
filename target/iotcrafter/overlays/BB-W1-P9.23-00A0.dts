/*
 * Virtual cape for onewire on connector pin P9.23
 */
/dts-v1/;
/plugin/;

#include <dt-bindings/board/am335x-bbw-bbb-base.h>
#include <dt-bindings/gpio/gpio.h>
#include <dt-bindings/pinctrl/am33xx.h>

/ {
	compatible = "ti,beaglebone", "ti,beaglebone-black", "ti,beaglebone-green";

	/* identification */
	part-number = "BB-W1-P9.23";
	version = "00A0";

	/* state the resources this cape uses */
	exclusive-use =
		/* the pin header uses */
		"P9.23";

	fragment@0 {
		target = <&am33xx_pinmux>;
		__overlay__ {

			dallas_w1_pins49: pinmux_dallas_w1_pins49 {
				pinctrl-single,pins = < 
					BONE_P9_23 0x37
				>;
			};
		};
	};

	fragment@1 {
		target-path="/";
		__overlay__ {

			onewire@49 {
				status = "okay";
				pinctrl-names = "default";
				pinctrl-0 = <&dallas_w1_pins49>;

				compatible = "w1-gpio";
				gpios = <&gpio1 17 GPIO_ACTIVE_HIGH>;
			};
		};
	};
};
